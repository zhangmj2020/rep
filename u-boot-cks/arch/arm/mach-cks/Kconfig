## u-boot-cks/arch/arm/mach-cks/Kconfig
```kconfig
if ARCH_CKS

config CKS_A53T28
	bool "Support CKS A53T28"
	select ARM64
	select SUPPORT_SPL
	select SPL
	help
	  The CKS_A53T28 cpu.

config CKS_SMARTNIC
	bool "Support CKS SMARTNIC"
	select ARM64
	help
	  The CKS_SMARTNIC cpu.

config CKS_CKS6Q64
	bool "Support CKS CKS6Q64"
	select ARM64
	help
	  The CKS6Q64 cpu.

config CKS_CKS6Q32
	bool "Support CKS CKS6Q32"
	help
	  The CKS6Q32 cpu.

endif

source "arch/arm/mach-cks/a53t28/Kconfig"
source "board/cks/fpga_cks_a53t28/Kconfig"
source "arch/arm/mach-cks/smartnic/Kconfig"
source "board/cks/fpga_cks_smartnic/Kconfig"
source "arch/arm/mach-cks/cks6q64/Kconfig"
source "board/cks/cks6q64_fpga/Kconfig"

source "arch/arm/mach-cks/cks6q32/Kconfig"
source "board/cks/cks6q32_fpga/Kconfig"
```

## u-boot-cks/arch/arm/mach-cks/a53t28/Kconfig
```kconfig
if CKS_A53T28
	
config SYS_SOC		
	default "cks-a53t28"

choice 
	prompt "CKS A53T28 board select"

config	TARGET_FPGA_CKS_A53T28
	bool "CKS A53T28 FPGA board"

endchoice

endif
```

## u-boot-cks/arch/arm/mach-cks/cks6q32/Kconfig
```kconfig
if CKS_CKS6Q32

config SYS_SOC
	default "cks-cks6q32"

choice 
	prompt "CKS CKS6Q32 board select"

config	TARGET_CKS6Q32_FPGA
	bool "CKS CKS6Q32 FPGA board"
	select CPU_V7A
	select SUPPORT_SPL
endchoice

endif
```

## u-boot-cks/arch/arm/mach-cks/cks6q64/Kconfig
```kconfig
if CKS_CKS6Q64
	
config SYS_SOC		
	default "cks-cks6q64"

choice 
	prompt "CKS CKS6Q64 board select"

config	TARGET_CKS6Q64_FPGA
	bool "CKS CKS6Q64 FPGA board"

endchoice

endif
```

## u-boot-cks/arch/arm/mach-cks/smartnic/Kconfig
```kconfig
if CKS_SMARTNIC
	
config SYS_SOC		
	default "cks-smartnic"

choice 
	prompt "CKS smartnic board select"

config	TARGET_FPGA_CKS_SMARTNIC
	bool "CKS SMARTNIC FPGA board"

endchoice

endif
```

## u-boot-cks/board/cks/cks6q32_fpga/Kconfig
```kconfig
if TARGET_CKS6Q32_FPGA

config SYS_BOARD
	default "cks6q32_fpga"

config SYS_VENDOR
	default "cks"

config SYS_CONFIG_NAME
	default "cks6q32_fpga"

endif
```

## u-boot-cks/board/cks/cks6q64_fpga/Kconfig
```kconfig
if TARGET_CKS6Q64_FPGA

config SYS_BOARD
	default "cks6q64_fpga"

config SYS_VENDOR
	default "cks"

config SYS_CONFIG_NAME
	default "cks6q64_fpga"

endif
```

## u-boot-cks/board/cks/fpga_cks_a53t28/Kconfig
```kconfig
if TARGET_FPGA_CKS_A53T28

config SYS_BOARD
	default "fpga_cks_a53t28"

config SYS_VENDOR
	default "cks"

config SYS_CONFIG_NAME
	default "fpga_cks_a53t28"

endif
```

## u-boot-cks/board/cks/fpga_cks_smartnic/Kconfig
```kconfig
if TARGET_FPGA_CKS_SMARTNIC

config SYS_BOARD
	default "fpga_cks_smartnic"

config SYS_VENDOR
	default "cks"

config SYS_CONFIG_NAME
	default "fpga_cks_smartnic"

endif
```

## u-boot-cks/configs/cks6q64_fpga_defconfig
```kconfig
CONFIG_ARM=y
CONFIG_ARCH_CPU_INIT=y
CONFIG_ARCH_CKS=y
CONFIG_SYS_TEXT_BASE=0x18004000
CONFIG_SYS_MALLOC_F_LEN=0x2000
CONFIG_NR_DRAM_BANKS=2
CONFIG_ARMV8_SET_SMPEN=y
CONFIG_ARMV8_SEC_FIRMWARE_SUPPORT=y
CONFIG_ARMV8_PSCI=y
CONFIG_ARMV8_PSCI_CPUS_PER_CLUSTER=4
CONFIG_CKS_CKS6Q64=y
CONFIG_DISTRO_DEFAULTS=y
CONFIG_SYS_CUSTOM_LDSCRIPT=y
CONFIG_SYS_LDSCRIPT="arch/arm/mach-cks/cks6q64/u-boot.lds"
CONFIG_FIT_SIGNATURE=y
CONFIG_LEGACY_IMAGE_FORMAT=y
CONFIG_SD_BOOT=y
CONFIG_USE_PREBOOT=y
CONFIG_LOGLEVEL=8
CONFIG_BOARD_LATE_INIT=y
# CONFIG_DISPLAY_CPUINFO is not set
CONFIG_SYS_PROMPT="cks_a53>"
CONFIG_CMD_MEMTEST=y
CONFIG_SYS_ALT_MEMTEST=y
CONFIG_CMD_CLK=y
CONFIG_CMD_DM=y
# CONFIG_CMD_FLASH is not set
# CONFIG_CMD_LOADB is not set
# CONFIG_CMD_LOADS is not set
CONFIG_CMD_MMC=y
CONFIG_CMD_MMC_SWRITE=y
# CONFIG_CMD_ECHO is not set
# CONFIG_CMD_ITEST is not set
# CONFIG_CMD_SOURCE is not set
# CONFIG_CMD_SETEXPR is not set
CONFIG_CMD_CACHE=y
# CONFIG_CMD_LED is not set
CONFIG_CMD_EXT4_WRITE=y
# CONFIG_ISO_PARTITION is not set
# CONFIG_EFI_PARTITION is not set
CONFIG_OF_CONTROL=y
CONFIG_OF_EMBED=y
CONFIG_DEFAULT_DEVICE_TREE="cks6q64-fpga"
CONFIG_ENV_IS_IN_FAT=y
CONFIG_ENV_FAT_INTERFACE="mmc"
CONFIG_ENV_FAT_DEVICE_AND_PART="0:1"
# CONFIG_NET is not set
CONFIG_DM=y
CONFIG_CLK=y
CONFIG_DM_I2C=y
CONFIG_LED=y
CONFIG_MMC_SDHCI=y
CONFIG_MMC_CKS=y
CONFIG_CONS_INDEX=0
CONFIG_PL011_SERIAL=y
CONFIG_FS_FAT_MAX_CLUSTSIZE=8192
# CONFIG_EFI_LOADER is not set
```

## u-boot-cks/configs/cks6q_fpga_defconfig
```kconfig
CONFIG_ARM=y
CONFIG_SYS_ICACHE_OFF=y
CONFIG_SYS_DCACHE_OFF=y
CONFIG_ARCH_CPU_INIT=y
CONFIG_SYS_L2CACHE_OFF=y
# CONFIG_USE_ARCH_MEMCPY is not set
# CONFIG_USE_ARCH_MEMSET is not set
CONFIG_SPL_LDSCRIPT="arch/arm/cpu/mach-cks/cks6q32/u-boot-spl.lds"
CONFIG_ARCH_CKS=y
CONFIG_SYS_TEXT_BASE=0x11000000
CONFIG_SPL_LIBCOMMON_SUPPORT=y
CONFIG_SPL_LIBGENERIC_SUPPORT=y
CONFIG_SYS_MALLOC_F_LEN=0x2000
CONFIG_SPL_SERIAL_SUPPORT=y
CONFIG_NR_DRAM_BANKS=1
CONFIG_SPL=y
CONFIG_CKS_CKS6Q32=y
CONFIG_SPL_TEXT_BASE=0x05bb0100
CONFIG_DISTRO_DEFAULTS=y
CONFIG_SD_BOOT=y
CONFIG_BOOTDELAY=3
CONFIG_USE_PREBOOT=y
CONFIG_LOGLEVEL=8
CONFIG_SYS_CONSOLE_IS_IN_ENV=y
CONFIG_SYS_CONSOLE_OVERWRITE_ROUTINE=y
CONFIG_BOARD_LATE_INIT=y
CONFIG_BOARD_EARLY_INIT_F=y
CONFIG_SYS_PROMPT="cks_a9>"
CONFIG_CMD_MEMTEST=y
CONFIG_SYS_ALT_MEMTEST=y
CONFIG_CMD_CLK=y
CONFIG_CMD_DM=y
# CONFIG_CMD_FLASH is not set
# CONFIG_CMD_LOADB is not set
# CONFIG_CMD_LOADS is not set
# CONFIG_CMD_ECHO is not set
# CONFIG_CMD_ITEST is not set
# CONFIG_CMD_SOURCE is not set
# CONFIG_CMD_SETEXPR is not set
CONFIG_CMD_CACHE=y
# CONFIG_CMD_LED is not set
CONFIG_CMD_EXT4_WRITE=y
# CONFIG_ISO_PARTITION is not set
# CONFIG_EFI_PARTITION is not set
CONFIG_OF_CONTROL=y
CONFIG_DEFAULT_DEVICE_TREE="cks6q32-fpga"
# CONFIG_NET is not set
CONFIG_DM=y
CONFIG_CLK=y
CONFIG_DM_I2C=y
CONFIG_LED=y
# CONFIG_MMC is not set
CONFIG_CONS_INDEX=0
CONFIG_PL011_SERIAL=y
CONFIG_FS_FAT_MAX_CLUSTSIZE=8192
# CONFIG_EFI_LOADER is not set
```

## u-boot-cks/configs/cks_a53t28_fpga_defconfig
```kconfig
CONFIG_ARM=y
CONFIG_SPL_SYS_DCACHE_OFF=y
CONFIG_ARCH_CPU_INIT=y
CONFIG_SPL_LDSCRIPT="arch/arm/mach-cks/a53t28/u-boot-spl.lds"
CONFIG_ARCH_CKS=y
CONFIG_SYS_TEXT_BASE=0x08380000
CONFIG_SPL_LIBCOMMON_SUPPORT=y
CONFIG_SPL_LIBGENERIC_SUPPORT=y
CONFIG_SYS_MALLOC_F_LEN=0x8000
CONFIG_SPL_MMC_SUPPORT=y
CONFIG_SPL_SERIAL_SUPPORT=y
CONFIG_NR_DRAM_BANKS=2
CONFIG_ARMV8_MULTIENTRY=y
CONFIG_ARMV8_SET_SMPEN=y
CONFIG_ARMV8_SEC_FIRMWARE_SUPPORT=y
CONFIG_ARMV8_PSCI=y
CONFIG_ARMV8_PSCI_CPUS_PER_CLUSTER=4
CONFIG_CKS_A53T28=y
CONFIG_LOCALVERSION=".1"
CONFIG_DISTRO_DEFAULTS=y
CONFIG_SYS_CUSTOM_LDSCRIPT=y
CONFIG_SYS_LDSCRIPT="arch/arm/mach-cks/a53t28/u-boot.lds"
CONFIG_FIT_SIGNATURE=y
CONFIG_LEGACY_IMAGE_FORMAT=y
CONFIG_SD_BOOT=y
CONFIG_USE_PREBOOT=y
CONFIG_LOGLEVEL=8
CONFIG_BOARD_LATE_INIT=y
# CONFIG_DISPLAY_CPUINFO is not set
CONFIG_SPL_LEGACY_IMAGE_CRC_CHECK=y
CONFIG_SPL_SEPARATE_BSS=y
CONFIG_SYS_MMCSD_RAW_MODE_U_BOOT_USE_SECTOR=y
CONFIG_SYS_MMCSD_RAW_MODE_U_BOOT_SECTOR=0x800
CONFIG_SPL_MMC_TINY=y
CONFIG_SPL_PAYLOAD="u-boot.img"
CONFIG_SPL_YMODEM_SUPPORT=y
CONFIG_SYS_PROMPT="cks_a53>"
CONFIG_CMD_SPL=y
CONFIG_CMD_MEMTEST=y
CONFIG_SYS_ALT_MEMTEST=y
CONFIG_CMD_CLK=y
CONFIG_CMD_DM=y
# CONFIG_CMD_FLASH is not set
# CONFIG_CMD_LOADB is not set
# CONFIG_CMD_LOADS is not set
CONFIG_CMD_MMC=y
CONFIG_CMD_MMC_SWRITE=y
# CONFIG_CMD_ECHO is not set
# CONFIG_CMD_ITEST is not set
# CONFIG_CMD_SOURCE is not set
# CONFIG_CMD_SETEXPR is not set
CONFIG_CMD_CACHE=y
# CONFIG_CMD_LED is not set
CONFIG_CMD_EXT4_WRITE=y
# CONFIG_SPL_DOS_PARTITION is not set
# CONFIG_ISO_PARTITION is not set
# CONFIG_EFI_PARTITION is not set
CONFIG_OF_CONTROL=y
CONFIG_OF_EMBED=y
CONFIG_DEFAULT_DEVICE_TREE="cks-a53t28-fpga"
CONFIG_ENV_IS_IN_FAT=y
CONFIG_ENV_FAT_INTERFACE="mmc"
CONFIG_ENV_FAT_DEVICE_AND_PART="0:1"
# CONFIG_NET is not set
CONFIG_DM=y
CONFIG_CLK=y
CONFIG_DM_I2C=y
CONFIG_LED=y
CONFIG_MMC_SDHCI=y
CONFIG_MMC_CKS=y
CONFIG_CONS_INDEX=0
CONFIG_PL011_SERIAL=y
CONFIG_FS_FAT_MAX_CLUSTSIZE=8192
# CONFIG_EFI_LOADER is not set
```

## u-boot-cks/configs/cks_smartnic_fpga_defconfig
```kconfig
CONFIG_ARM=y
CONFIG_POSITION_INDEPENDENT=y
CONFIG_ARCH_CPU_INIT=y
CONFIG_ARCH_CKS=y
CONFIG_SYS_TEXT_BASE=0x08080000
CONFIG_SYS_MALLOC_F_LEN=0x1000
CONFIG_NR_DRAM_BANKS=0
CONFIG_ARMV8_MULTIENTRY=y
CONFIG_ARMV8_SET_SMPEN=y
CONFIG_ARMV8_SEC_FIRMWARE_SUPPORT=y
CONFIG_ARMV8_PSCI=y
CONFIG_ARMV8_PSCI_CPUS_PER_CLUSTER=4
CONFIG_CKS_SMARTNIC=y
# CONFIG_LOCALVERSION_AUTO is not set
CONFIG_ENV_VARS_UBOOT_CONFIG=y
CONFIG_SYS_CUSTOM_LDSCRIPT=y
CONFIG_SYS_LDSCRIPT="arch/arm/mach-cks/smartnic/u-boot.lds"
CONFIG_FIT_SIGNATURE=y
CONFIG_LEGACY_IMAGE_FORMAT=y
CONFIG_SD_BOOT=y
CONFIG_LOGLEVEL=8
CONFIG_LOG=y
CONFIG_BOARD_LATE_INIT=y
# CONFIG_DISPLAY_CPUINFO is not set
CONFIG_HUSH_PARSER=y
CONFIG_SYS_PROMPT="smartnic>"
# CONFIG_CMD_BOOTD is not set
# CONFIG_BOOTM_LINUX is not set
# CONFIG_BOOTM_NETBSD is not set
# CONFIG_BOOTM_PLAN9 is not set
# CONFIG_BOOTM_RTEMS is not set
# CONFIG_CMD_IMI is not set
# CONFIG_CMD_XIMG is not set
# CONFIG_CMD_LZMADEC is not set
# CONFIG_CMD_UNZIP is not set
CONFIG_CMD_CLK=y
CONFIG_CMD_DM=y
# CONFIG_CMD_FLASH is not set
# CONFIG_CMD_LOADB is not set
# CONFIG_CMD_LOADS is not set
CONFIG_CMD_SF=y
CONFIG_CMD_SF_TEST=y
# CONFIG_CMD_ECHO is not set
# CONFIG_CMD_ITEST is not set
# CONFIG_CMD_SOURCE is not set
# CONFIG_CMD_SETEXPR is not set
CONFIG_CMD_CACHE=y
# CONFIG_CMD_LED is not set
# CONFIG_CMD_MISC is not set
# CONFIG_PARTITIONS is not set
CONFIG_OF_CONTROL=y
CONFIG_OF_EMBED=y
CONFIG_DEFAULT_DEVICE_TREE="cks-smartnic-fpga"
# CONFIG_NET is not set
CONFIG_DM=y
CONFIG_HAVE_BLOCK_DEVICE=y
CONFIG_CLK=y
CONFIG_DM_I2C=y
CONFIG_LED=y
# CONFIG_MMC is not set
CONFIG_DM_SPI_FLASH=y
CONFIG_SPI_FLASH=y
CONFIG_SPI_FLASH_SPANSION=y
CONFIG_SPI_FLASH_GIGADEVICE=y
# CONFIG_SPI_FLASH_USE_4K_SECTORS is not set
CONFIG_SPI_FLASH_MTD=y
CONFIG_CONS_INDEX=0
CONFIG_PL011_SERIAL=y
CONFIG_SPI=y
CONFIG_DM_SPI=y
CONFIG_CADENCE_QSPI=y
CONFIG_FS_FAT=y
CONFIG_FAT_WRITE=y
CONFIG_FS_FAT_MAX_CLUSTSIZE=8192
CONFIG_LZMA=y
# CONFIG_EFI_LOADER is not set
```
