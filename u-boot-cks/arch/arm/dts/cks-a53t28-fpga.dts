// SPDX-License-Identifier: GPL-2.0+
/*
 *  Copyright (C) 2011 - 2015 Xilinx
 *  Copyright (C) 2012 National Instruments Corp.
 */
/dts-v1/;

/ {
	model = "CKS A53T28 FPGA board";
	compatible = "cks,cks-a53t28";

	memory@0x40000000 {
		device_type = "memory";
		reg = <0x40000000 0x80000000>;
	};

	chosen {
		bootargs = "";
		stdout-path = "serial0:115200n8";
	};

};
